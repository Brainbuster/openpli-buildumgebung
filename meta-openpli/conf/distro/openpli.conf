## meta-openpli/conf/distro/openpli.conf
```bitbake
#@TYPE: Distribution
#@NAME: OpenPLi
#@DESCRIPTION: Embedded Linux Distribution Configuration for STB's

DISTRO_FEATURES_BACKFILL_CONSIDERED += "pulseaudio"

DISTRO_NAME ?= "openpli"
DISTRO_HOST ?= "feed.yt"
DISTRO_VERSION = "4"
DISTRO_TYPE ?= "release"

PLISVNURL ?= "svn://svn.code.sf.net/p/openpli/code"
PLISVNBRANCH ?= "trunk"

IPKG_VARIANT = "opkg"

FEED_NAME ?= "${DISTRO_NAME}-${DISTRO_VERSION}"
DISTRO_FEED_URI ?= "http://${DISTRO_HOST}/bre2ze/feeds/${FEED_NAME}"
DISTRO_FEED_PREFIX ?= "${DISTRO_NAME}"

IMAGE_NAME = "${IMAGE_BASENAME}-${DISTRO_VERSION}-${MACHINE}-${DATE}"
# We don't need a link, but a bug in OE makes image creation fail when
# the link name is empty.
IMAGE_LINK_NAME = "${IMAGE_BASENAME}"
CACHE ?= "${TMPDIR}/cache/${LIBC}/${MACHINE}"
DEPLOY_DIR ?= "${TMPDIR}/deploy/${LIBC}"
DEPLOY_DIR_IMAGE = "${DEPLOY_DIR}/images/${MACHINE}"

VIRTUAL-RUNTIME_dev_manager = "busybox-mdev"
VIRTUAL-RUNTIME_login_manager = "busybox"
VIRTUAL-RUNTIME_init_manager = "sysvinit"
VIRTUAL-RUNTIME_initscripts = "initscripts"
PREFERRED_PROVIDER_module-init-tools = "busybox"

PREFERRED_PROVIDER_jpeg = "jpeg"
PREFERRED_PROVIDER_jpeg-native = "jpeg-native"
PREFERRED_PROVIDER_libfribidi = "libfribidi"
PREFERRED_PROVIDER_libcrypto = "openssl"
PREFERRED_PROVIDER_libssl = "openssl"

PREFERRED_PROVIDER_cifs ?= "cifs"
PREFERRED_PROVIDER_cifs-doc ?= "cifs"
PREFERRED_VERSION_cifs ?= "5.9"

PREFERRED_VERSION_samba ?= "3.6.25"

PREFERRED_VERSION_python-pyopenssl ?= "0.14"
PREFERRED_VERSION_wpa-supplicant ?= "2.4"
PREFERRED_VERSION_libav ?= "9.18"

PREFERRED_PROVIDERS += "virtual/${TARGET_PREFIX}gcc-initial:gcc-cross-initial"
PREFERRED_PROVIDERS += "virtual/${TARGET_PREFIX}gcc-intermediate:gcc-cross-intermediate"
PREFERRED_PROVIDERS += "virtual/${TARGET_PREFIX}gcc:gcc-cross"
PREFERRED_PROVIDERS += "virtual/${TARGET_PREFIX}g++:gcc-cross"

# qtwebkit
PREFERRED_VERSION_qt4-native ?= "4.8.7"
PREFERRED_VERSION_qt4-tools-sdk ?= "4.8.7"
PREFERRED_VERSION_qt4-embedded ?= "4.8.7"
PREFERRED_VERSION_qt4-embedded-gles ?= "4.8.7"
PREFERRED_VERSION_qt4-x11-free = "4.8.7"
PREFERRED_VERSION_qt4-x11-free-gles ?= "4.8.7"
PREFERRED_PROVIDER_qt4-tools-native = "qt4-native"

# Gstreamer 1.x
GST_VERSION = "1.0"

LICENSE_FLAGS_WHITELIST = "commercial"
COMMERCIAL_AUDIO_PLUGINS ?= "gst-plugins-ugly-mad gst-plugins-ugly-mpegaudioparse"
COMMERCIAL_VIDEO_PLUGINS ?= "gst-plugins-ugly-mpeg2dec gst-plugins-ugly-mpegstream gst-plugins-bad-mpegvideoparse"

# OE optimization defaults to -O2 which makes for much larger binaries.
# Override here to use -Os instead, resulting in smaller images.
FULL_OPTIMIZATION = "-Os -pipe ${DEBUG_FLAGS}"
# build some core libs with better compiler optimization for better performance
O3_OPT = "-O3 -pipe ${DEBUG_FLAGS}"
FULL_OPTIMIZATION_pn-flac = "${O3_OPT}"
FULL_OPTIMIZATION_pn-jpeg = "${O3_OPT}"
FULL_OPTIMIZATION_pn-lame = "${O3_OPT}"
FULL_OPTIMIZATION_pn-liba52 = "${O3_OPT}"
FULL_OPTIMIZATION_pn-libdca = "${O3_OPT}"
FULL_OPTIMIZATION_pn-libgcrypt = "${O3_OPT}"
FULL_OPTIMIZATION_pn-libmad = "${O3_OPT}"
FULL_OPTIMIZATION_pn-libogg = "${O3_OPT}"
FULL_OPTIMIZATION_pn-libpng = "${O3_OPT}"
FULL_OPTIMIZATION_pn-libsamplerate = "${O3_OPT}"
FULL_OPTIMIZATION_pn-libvorbis = "${O3_OPT}"
FULL_OPTIMIZATION_pn-tremor = "${O3_OPT}"
FULL_OPTIMIZATION_pn-zlib = "${O3_OPT}"

PYTHON_BASEVERSION ?= "2.7"
PREFERRED_VERSION_python ?= "2.7.9"
PREFERRED_VERSION_python-native ?= "2.7.9"

# Force the older version of liberation-fonts until we fix the fontforge issue
PREFERRED_VERSION_liberation-fonts ?= "1.04"

PREFERRED_VERSION_udev ?= "182"

PREFERRED_VERSION_gstreamer1.0-plugins-ugly ?= "1.6.0"
PREFERRED_VERSION_gstreamer1.0-plugins-good ?= "1.6.0"
PREFERRED_VERSION_gstreamer1.0-plugins-base ?= "1.6.0"
PREFERRED_VERSION_gstreamer1.0-plugins-bad ?= "1.6.0"
PREFERRED_VERSION_gstreamer1.0-libav ?= "1.6.0"
PREFERRED_VERSION_gstreamer1.0 ?= "1.6.0"


DISTRO_FEATURES ?= "alsa bluetooth ext2 largefile wifi nfs zeroconf ${DISTRO_FEATURES_LIBC} smbfs"

QA_LOGFILE = "${TMPDIR}/qa.log"

OEINCLUDELOGS ?= "yes"
KERNEL_CONSOLE ?= "ttyS0"

BB_GENERATE_MIRROR_TARBALLS ??= "0"

NO32LIBS ??= "1"

# Missing checksums should raise an error
BB_STRICT_CHECKSUM = "0"

# Place output in "tmp" as before, not "tmp-glibc"
TCLIBCAPPEND = ""

# Don't grab feeds for lower level archs, e.g. mips32el should not
# attempt to fetch mipsel, and armv7 need not fetch armv5 etcetera.
DISTRO_FEED_ARCHS = "all ${TUNE_PKGARCH} ${MACHINE_ARCH}"

# add support for extra feeds
PACKAGE_ARCHS += " 3rdparty ${MACHINE}_3rdparty private"

# temporary workaround for vuplus-dvbmediasink needing non-HEAD commit
SRCREV_pn-gst-plugin-vuplus-dvbmediasink = "a02fcc119ee7c4c37d7ffd989a898411ac8fc48a"

LICENSE_FLAGS_WHITELIST = "commercial_gst-plugins-ugly commercial_lame commercial_libmad commercial_mpeg2dec commercial_ffmpeg commercial_libav commercial_x264 commercial_gstreamer1.0-libav commercial_gstreamer1.0-plugins-ugly"
COMMERCIAL_AUDIO_PLUGINS ?= "gst-plugins-ugly-mad gst-plugins-ugly-mpegaudioparse gstreamer1.0-plugins-ugly-mad"
COMMERCIAL_VIDEO_PLUGINS ?= "gst-plugins-ugly-mpeg2dec gst-plugins-ugly-mpegstream gst-plugins-bad-mpegvideoparse gstreamer1.0-plugins-ugly-mpeg2dec"
```
